## esp32-cam/main/Kconfig.projbuild
```kconfig
menu "AES Firmware Configuration"

    config AES_DEVICE_ID
        string "Device ID (registry key + MQTT topic suffix)"
        default "esp32-cam-02"
        help
            Must match an entry in config/device_registry.json.
            Telemetry publishes to aes/telemetry/<AES_DEVICE_ID>.

    config AES_FIRMWARE_VERSION
        string "Firmware version reported in authenticated telemetry"
        default "0.1.0"
        help
            Increment for every approved release. Gate 2 binds this value to the
            compiled artifact and deployment approval.

    config AES_WIFI_SSID
        string "WiFi SSID"
        default "AES-Gateway"

    config AES_WIFI_PASSWORD
        string "WiFi password"
        default ""
        help
            Deliberately empty in version control (CWE-798). Set it per build:
              idf.py menuconfig   (this menu), or
              put CONFIG_AES_WIFI_PASSWORD="..." in sdkconfig.secrets and build with
              SDKCONFIG_DEFAULTS="sdkconfig.defaults;sdkconfig.secrets"
            sdkconfig.secrets is gitignored.

    config AES_MQTT_BROKER_URI
        string "MQTT broker URI"
        default "mqtts://192.168.4.1:8883"
        help
            TLS-only gateway broker. The ignored local srv_cert.crt must contain
            the trusted public CA certificate, never the CA private key.

    config AES_MQTT_USERNAME
        string "Per-device MQTT username"
        default ""
        help
            Must match AES_DEVICE_ID so the broker ACL pattern restricts this
            identity to aes/telemetry/<username>. Set in sdkconfig.secrets.

    config AES_MQTT_PASSWORD
        string "Per-device MQTT password"
        default ""
        help
            Unique password provisioned by the gateway. Set in
            sdkconfig.secrets; never commit it.

endmenu
```
